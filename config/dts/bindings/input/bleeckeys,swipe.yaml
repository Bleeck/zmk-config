## config/dts/bindings/input/bleeckeys,swipe.yaml
```yaml
description: |
  Input processor for bleecKEYS: turns one swipe into one tap of a behavior.
  Movement is counted per touch; the first axis to reach tick fires the
  binding for its direction, once, and the rest of that touch is ignored.

compatible: "bleeckeys,swipe"

include: ip_zero_param.yaml

properties:
  bindings:
    type: phandle-array
    required: true
    description: Exactly four bindings, in the order right, left, up, down.
  tick:
    type: int
    required: true
    description: Movement along one axis needed to fire (pad is scaled to 1024).
```

## config/dts/bindings/input/bleeckeys,trackpad.yaml
```yaml
description: |
  Input processor for bleecKEYS: tap to click, double tap to double click,
  tap then touch-and-hold to drag (button held until the finger lifts), and
  edge motion (the cursor keeps moving while a finger rests at the pad's edge).
  Goes after zip_absolute_to_relative.

compatible: "bleeckeys,trackpad"

include: ip_zero_param.yaml

properties:
  width:
    type: int
    default: 1024
    description: Pad width in absolute units (absolute-mode-scale-to-width).
  height:
    type: int
    default: 1024
    description: Pad height in absolute units (absolute-mode-scale-to-height).
  tap-ms:
    type: int
    default: 150
    description: A touch shorter than this (and moving less than tap-max-move) is a tap.
  tap-max-move:
    type: int
    default: 30
    description: Most movement a tap may have, in pad units.
  double-tap-ms:
    type: int
    default: 150
    description: |
      Time after a tap is detected (touch-end-ms after the lift) in which a second
      touch makes a double tap or a drag.
  touch-end-ms:
    type: int
    default: 100
    description: |
      No report for this long means the finger lifted. The pad's reports reach the
      left half over BLE with gaps of up to ~80 ms during a continuous touch, so
      shorter values split drags into accidental taps.
  edge-margin:
    type: int
    default: 60
    description: Width of the edge border, in pad units.
  edge-speed:
    type: int
    default: 4
    description: Cursor movement added per report while the finger is in the edge border.
```

## config/dts/bindings/sensor/bleeckeys,battery.yaml
```yaml
description: |
  Battery level for bleecKEYS: reads the voltage from another battery sensor
  and maps min-mv..max-mv linearly to 0..100%.

compatible: "bleeckeys,battery"

include: base.yaml

properties:
  voltage-source:
    type: phandle
    required: true
    description: Battery sensor that provides SENSOR_CHAN_GAUGE_VOLTAGE.
  min-mv:
    type: int
    required: true
    description: Voltage reported as 0%.
  max-mv:
    type: int
    required: true
    description: Voltage reported as 100%.
```
