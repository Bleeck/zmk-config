## config/boards/shields/bleeckeys/Kconfig.defconfig
```kconfig
if SHIELD_BLEECKEYS_LEFT

# Name must be less than 16 characters long!
config ZMK_KEYBOARD_NAME
    default "Bleeckeys"

config ZMK_SPLIT_ROLE_CENTRAL
    default y

endif

if SHIELD_BLEECKEYS_LEFT || SHIELD_BLEECKEYS_RIGHT

config ZMK_SPLIT
    default y

endif
```

## config/boards/shields/bleeckeys/Kconfig.shield
```kconfig
# No whitespace after the comma or in your part name!
config SHIELD_BLEECKEYS_LEFT
    def_bool $(shields_list_contains,bleeckeys_left)

# No whitespace after the comma or in your part name!
config SHIELD_BLEECKEYS_RIGHT
    def_bool $(shields_list_contains,bleeckeys_right)
```
